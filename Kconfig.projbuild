## Kconfig.projbuild
```kconfig
menu "SIM68MD"

    config SIM68MD_SYNC_TIME
        bool "Enable sync time."
        default y
        help
            Установка системного времени из данных GPS.

    choice
        prompt "Choose Power down Version"
        default SIM68MD_PD_1
        help
            Выберите версию выключения GPS.

        config SIM68MD_PD_1
            bool "SIM68MD_PD_1"
            help
                Версия $PAIR.

        config SIM68MD_PD_2
            bool "SIM68MD_PD_2"
            help
                Версия $PMTK161
    endchoice

    config SIM68MD_NMEA_TIMEOUT
        int "NMEA timeout in sec"
        range 2 600
        default 2
        help
            NMEA timeout in sec.

    config SIM68MD_NOFIX_RESTART
        int "Restart module after N minutes without fix"
        range 0 1440
        default 30
        help
            Если NMEA идёт, а фиксации нет столько минут подряд, модуль перезапускается
            командой $PAIR023 ($PMTK103 для PMTK). Отсчёт идёт только в режиме Run и
            начинается заново при каждом включении модуля, поэтому в режиме сеансов
            поиска (короче этого времени) перезапуска не бывает. 0 - не перезапускать.

endmenu
```
